#include "sys.h"

// 重启标志
uint8_t flag = 0;
// 模式标志
uint8_t mode_flag = 0;
// 信号的移相
double diff_phi_per5_1 = 0;
double diff_phi_per5_0 = 0;
int change_phi = 0;

double pos_angle_0; // 转换为延迟0-2pi，全部为整数的角度，重建信号延迟的相位
double pos_angle_1; // 转换为延迟0-2pi，全部为整数的角度，重建信号延迟的相位
double temp_double;
short temp_short;
double angle;
int delayTime0;
int delayTime1;

// 信号频率
unsigned char fre[2];
// 信号种类
unsigned char wave_type[2];

short ADCConvertedValue[1000];

double modulus(double I, double Q);
double corr1000_200(short *data, short *mask);
void get_pos_angle(void);
void cal_2frqs(unsigned char *frq);
void fft_cal_2types(unsigned char *frq, unsigned char *wave_type);

// 输出波形
extern uint16_t meDA1_Value[DA1_Value_Length];
extern uint16_t meDA2_Value[DA1_Value_Length];

// 采样数据
extern u16 ADC1_ConvertedValue[ADC1_DMA_Size];

// 标准频率sin与cos表
short DAC_SIN[200 * 19] =
    // 第一行是20K -> 1s 10K
    { // DAC正弦缓冲区,每行 200点。第一行有2个正弦波，第三行有4个……第19行有20个
        2142, 2236, 2329, 2421, 2512, 2600, 2687, 2771, 2852, 2930, 3004, 3075,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 2048,
        2189, 2329, 2466, 2600, 2729, 2852, 2967, 3075, 3173, 3262, 3339, 3405,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 2048,
        2236, 2421, 2600, 2771, 2930, 3075, 3204, 3314, 3405, 3475, 3521, 3545,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 2048,
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        2930, 3475, 3475, 2930, 2048, 1166, 621, 621, 1166, 2048, 2930, 3475,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 1166, 2048};

short DAC_COS[200 * 19] =
    { // DAC余弦缓冲区,每行 200点。第一行有2个正弦波，第三行有4个……第19行有20个
        3545, 3536, 3521, 3501, 3475, 3443, 3405, 3362, 3314, 3262, 3204, 3141,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 3548,
        3541, 3521, 3488, 3443, 3385, 3314, 3233, 3141, 3040, 2930, 2812, 2687,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 3548,
        3536, 3501, 3443, 3362, 3262, 3141, 3004, 2852, 2687, 2512, 2329, 2142,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 3548,
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        3262, 2512, 1584, 834, 548, 834, 1584, 2512, 3262, 3548, 3262, 2512,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 3262, 3548};

short Tri_Wave[200 * 19] =
    {
        608, 668, 728, 788, 848, 908, 968, 1028, 1088, 1148, 1208, 1268,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 548,
        638, 728, 818, 908, 998, 1088, 1178, 1268, 1358, 1448, 1538, 1628,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 548,
        668, 788, 908, 1028, 1148, 1268, 1388, 1508, 1628, 1748, 1868, 1988,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 548,
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        1148, 1748, 2348, 2948, 3548, 2948, 2348, 1748, 1148, 548, 1148, 1748,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 1148, 548};

// 采样完成标志，保证同步调相
extern u8 do_ad_flag1;
extern u8 do_ad_flag2;

int main()
{
again:
    wave_type[0] = 0;
    wave_type[1] = 0;
    Serial_Init();
    ADC_GPIO_Init();             // ADC引脚初始化。
    TIM3_Config();               // 触发ADC采样频率，采样频率2MHz
    ADC_Config();                // ADC 2000K采样频率，采集6000个数据，需要花费3ms
    ADC_DMA_Trig(ADC1_DMA_Size); // 开始AD采集，设置采样点数
    for (int i = 0; i < 10000; i++)
        ; // 卡一会
    cal_2frqs(fre);
    fft_cal_2types(fre, wave_type);

    diff_phi_per5_1 = 1166.666666 / (fre[1] * 5 + 10);
    diff_phi_per5_0 = 1166.666666 / (fre[0] * 5 + 10);

    if (wave_type[0] == 0)
    {
        for (int i = 0; i < 200; i++)
        {
            meDA1_Value[i] = DAC_SIN[(fre[0]) * 200 + i];
        }
    }
    else
    {
        for (int i = 0; i < 200; i++)
        {
            meDA1_Value[i] = Tri_Wave[(fre[0]) * 200 + i];
        }
    }
    if (wave_type[1] == 0)
    {
        for (int i = 0; i < 200; i++)
        {
            meDA2_Value[i] = DAC_SIN[(fre[1]) * 200 + i];
        }
    }
    else
    {
        for (int i = 0; i < 200; i++)
        {
            meDA2_Value[i] = Tri_Wave[(fre[1]) * 200 + i];
        }
    }

    TIM4_Init();
    DA1_Init();
    TIM6_Init();
    DA2_Init();

    // 同时启动定时器，保证DA初相无偏移
    TIM_Cmd(TIM4, ENABLE);
    TIM_Cmd(TIM6, ENABLE);

    // 实时相位校正
    while (1)
    {
        if (mode_flag == 0) // 基础部分
        {
            // 让高频先调相
            do_ad_flag2 = 0;
            while (do_ad_flag2 == 0);
            ADC_DMA_Trig(ADC1_DMA_Size);
            get_pos_angle();
            delayTime1 = (8400.0 * pos_angle_1 / (3.1415926 * ((double)fre[1] + 2.0)) + 0.5);
            TIM6->CNT = 65535 - (delayTime1 - TIM6->CNT);

            // 让低频再调相
            do_ad_flag1 = 0;
            while (do_ad_flag1 == 0);
            ADC_DMA_Trig(ADC1_DMA_Size);
            get_pos_angle();
            delayTime0 = (8400.0 * pos_angle_0 / (3.1415926 * ((double)fre[0] + 2.0)) + 0.5);
            TIM4->CNT = 65535 - (delayTime0 - TIM4->CNT);
        }
        else    // 拓展部分
        {
            // 低频信号的延迟相位转化为延时时间
            int t = (double)change_phi / 360.0 * (1000.0 / (fre[1] * 2.0 + 10.0)) * 29.71;
            if (change_phi != 0)
            {
                TIM4->CNT = 65535 - (t)-TIM4->CNT;
                change_phi = 0;
            }
        }
        if (flag == 1)
        {
            // 系统软件重启
            NVIC_SystemReset();
            // 全部归零，避免影响
            wave_type[0] = 0;
            wave_type[1] = 0;
            flag = 0;
            change_phi = 0;
            goto again;
        }
    }
}

// 确定频率用
double corr1000_200(short *data, short *mask)
{
    double res = 0;
    short i;
    for (i = 0; i < 1000; i++)
        res = res + (data[i] - 2048) * (mask[i % 200] - 2048); // 注意SIN与COS模版要减去直流偏置，才是真正的信号
    return res;
}

// 计算IQ分量的模的长度
double modulus(double I, double Q)
{
    double temp_double;
    temp_double = sqrt(I * I + Q * Q);
    return temp_double;
}

// 计算参与叠加的两个正弦信号的频率
void cal_2frqs(unsigned char *frq) 
{
    double corr_sin_double; // 用于存放C与所有19种正弦相关计算的结果
    double corr_cos_double; // 用于存放C与所有19种余弦相关计算的结果
    double mag[19];         // 用于存放输入信号与所有19种信号相关计算的模
    double temp_double[19], sort_temp;
    unsigned char i, j, temp_char;
    for (i = 0; i < 19; i++)
    {
        corr_sin_double = corr1000_200(ADCConvertedValue, DAC_SIN + 200 * i);
        corr_cos_double = corr1000_200(ADCConvertedValue, DAC_COS + 200 * i);
        mag[i] = modulus(corr_sin_double, corr_cos_double);
        temp_double[i] = mag[i];
    }
    // 冒泡法对大小进行排序
    for (i = 0; i < 19 - 1; i++)
    {
        for (j = 0; j < 19 - i - 1; j++)
        {
            if (temp_double[j] < temp_double[j + 1])
            {
                sort_temp = temp_double[j];
                temp_double[j] = temp_double[j + 1];
                temp_double[j + 1] = sort_temp;
            }
        }
    }
    // 寻找最大值序号
    for (i = 0; i < 19; i++)
    {
        if (mag[i] == temp_double[0]) // 找到最大数
            frq[0] = i;
        if (mag[i] == temp_double[1]) // 找到第二大数
            frq[1] = i;
    }
    if (frq[0] > frq[1])
    { // 把频率低的放在第一个位置，如果颠倒就换一下
        temp_char = frq[0];
        frq[0] = frq[1];
        frq[1] = temp_char;
    }
}

// 计算相位偏移
void get_pos_angle(void)
{
    unsigned char i = 0;
    double temp_double_sin = corr1000_200(ADCConvertedValue, DAC_SIN + 200 * fre[0]);
    double temp_double_cos = corr1000_200(ADCConvertedValue, DAC_COS + 200 * fre[0]);
    double temp_double_angle_0 = atan2(temp_double_cos, temp_double_sin);

    if (temp_double_angle_0 < 0) // atan2函数计算得到的相位差在-pi到pi，但当其小于0时，DAC输出的信号无法提前相位，只能将所有相位全部延迟一个周期，即进行一个周期的求补操作
        pos_angle_0 = -temp_double_angle_0;
    else
        pos_angle_0 = 2 * 3.1415926 - temp_double_angle_0;

    temp_double_sin = corr1000_200(ADCConvertedValue, DAC_SIN + 200 * fre[1]);
    temp_double_cos = corr1000_200(ADCConvertedValue, DAC_COS + 200 * fre[1]);
    double temp_double_angle_1 = atan2(temp_double_cos, temp_double_sin);

    if (temp_double_angle_1 < 0) // atan2函数计算得到的相位差在-pi到pi，但当其小于0时，DAC输出的信号无法提前相位，只能将所有相位全部延迟一个周期，即进行一个周期的求补操作
        pos_angle_1 = -temp_double_angle_1;
    else
        pos_angle_1 = 2 * 3.1415926 - temp_double_angle_1;
}

// 提高部分
void fft_cal_2types(unsigned char *frq, unsigned char *wave_type) // 根据输入信号及已经判断出来的频率值，通过FFT结果判断信号类型是三角波（1）还是正弦波（0）
// 第一个参数指针指向的数组，其中存放的是之前的其他函数计算出来的两个信号的频率
// 第二个参数指正指向的数组用于存放这两个信号的波形种类，0为正弦，其他值为三角波。需要在本函数中计算产生
{
    short indata[2048], outdata[2048], i;
    int mag[512], sum = 0, average;
    unsigned short index;                      // 输入信号的频率对应的索引值
    unsigned short harmo3_index, harmo5_index; // 输入信号三次和五次谐波频率对应的索引值
    float temp_float;
    float mag_1harmo, mag_3harmo, k; // 一次和三次谐波上的能量及其比值
    float mag_5harmo;                // 五次谐波上的能量
    _Bool conti;

    for (i = 0; i < 1024; i++) // 计算信号平均值
        sum = sum + ADCConvertedValue[i];
    average = sum / 1024;
    for (i = 0; i < 1024; i++)
    {
        indata[2 * i] = ADCConvertedValue[i] - average; // 减去平均值是为了降低直流分量
        indata[2 * i + 1] = 0;
    }
    cr4_fft_1024_stm32(outdata, indata, 1024);                                              // 注意阅读关于输入输出数据存放格式的描述
    for (i = 0; i < 512; i++)                                                               // FFT结果幅度谱是左右对称的，只需要算一半
        mag[i] = outdata[2 * i] * outdata[2 * i] + outdata[2 * i + 1] * outdata[2 * i + 1]; // sqrt(outdata[2*i] * outdata[2*i] + outdata[2*i + 1] * outdata[2*i + 1]);

    //////////计算输入信号频率及其三次谐波频率对应在FFT结果数组中的索引值//////////
    //////初步判断第一个信号的类型//////////////
    temp_float = (float)frq[0] * 5 + 10; // 计算输入索引值所对应的真实频率，单位为KHz
    temp_float = temp_float / 500;       // 采样率为1MSPS，则输入频率是奈奎斯特频率的多少倍
    temp_float = temp_float * 512;       // 计算输入信号频率对应的数组索引
    index = temp_float + 0.5;            // 进行四舍五入取整

    temp_float = (float)frq[0] * 5 + 10; // 计算输入索引值所对应的真实频率，单位为KHz
    temp_float = temp_float / 500;       // 采样率为1MSPS，则输入频率是奈奎斯特频率的多少倍
    temp_float = temp_float * 3 * 512;   // 计算三倍基频对应的数组索引
    harmo3_index = temp_float + 0.5;     // 进行四舍五入取整

    mag_1harmo = mag[index - 1] + mag[index] + mag[index + 1];
    mag_3harmo = mag[harmo3_index - 1] + mag[harmo3_index] + mag[harmo3_index + 1];
    k = mag_1harmo / mag_3harmo;
    if (k > 200)
        wave_type[0] = 0; // 三次谐波较小，说明是正弦波
    else
        wave_type[0] = 1; // 三次谐波较大，说明是三角波
    //////////初步判断第二个信号的类型////////////////
    temp_float = (float)frq[1] * 5 + 10; // 计算输入索引值所对应的真实频率，单位为KHz
    temp_float = temp_float / 500;       // 采样率为1MSPS，则输入频率是奈奎斯特频率的多少倍
    temp_float = temp_float * 512;       // 计算输入信号频率对应的数组索引
    index = temp_float + 0.5;            // 进行四舍五入取整

    temp_float = (float)frq[1] * 5 + 10; // 计算输入索引值所对应的真实频率，单位为KHz
    temp_float = temp_float / 500;       // 采样率为1MSPS，则输入频率是奈奎斯特频率的多少倍
    temp_float = temp_float * 3 * 512;   // 计算三倍基频对应的数组索引
    harmo3_index = temp_float + 0.5;     // 进行四舍五入取整

    mag_1harmo = mag[index - 1] + mag[index] + mag[index + 1];
    mag_3harmo = mag[harmo3_index - 1] + mag[harmo3_index] + mag[harmo3_index + 1];
    k = mag_1harmo / mag_3harmo;
    if (k > 200)
        wave_type[1] = 0; // 三次谐波较小，说明是正弦波
    else
        wave_type[1] = 1; // 三次谐波较大，说明是三角波

    ////////对第二个信号刚好等于第一个信号三倍频率特殊情况，需要重新判断第一个信号的类型/////
    // 上面的初步判断算有问题的是：第二个信号四第一个信号三倍频率的情况，只有可能包括：
    // 1、第一个信号是10K，第二个信号是30K
    // 2、第一个信号是15K，第二个信号是45K
    // 3、第一个信号是20K，第二个信号是60K
    // 4、第一个信号是25K，第二个信号是75K
    // 5、第一个信号是30K，第二个信号是90K
    conti = ((frq[0] == 0) & (frq[1] == 4)) | ((frq[0] == 1) & (frq[1] == 7)) | ((frq[0] == 2) & (frq[1] == 10)) | ((frq[0] == 3) & (frq[1] == 13)) | ((frq[0] == 4) & (frq[1] == 16));
    if (conti)
    {
        // 计算五次谐波能量和1次谐波能量之比
        temp_float = (float)frq[0] * 5 + 10; // 计算输入索引值所对应的真实频率，单位为KHz
        temp_float = temp_float / 500;       // 采样率为1MSPS，则输入频率是奈奎斯特频率的多少倍
        temp_float = temp_float * 512;       // 计算输入信号频率对应的数组索引
        index = temp_float + 0.5;            // 进行四舍五入取整
        mag_1harmo = mag[index - 1] + mag[index] + mag[index + 1];
        temp_float = (float)frq[0] * 5 + 10; // 计算输入索引值所对应的真实频率，单位为KHz
        temp_float = temp_float / 500;       // 采样率为1MSPS，则输入频率是奈奎斯特频率的多少倍
        temp_float = temp_float * 5 * 512;   // 计算5倍基频对应的数组索引
        harmo5_index = temp_float + 0.5;     // 进行四舍五入取整
        mag_5harmo = mag[harmo5_index - 1] + mag[harmo5_index] + mag[harmo5_index + 1];
        k = mag_1harmo / mag_5harmo;
        if (k > 200)
            wave_type[0] = 0; // 5次谐波较小，说明是正弦波
        else
            wave_type[0] = 1; // 5次谐波较大，说明是三角波
    }
}
